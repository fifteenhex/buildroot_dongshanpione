## br2dongshanpione/Config.in
```kconfig
config BR2_DONGSHANPIONE
        bool "dongshanpi one"
        select BR2_CHENXING
        select BR2_LINUX_KERNEL

config BR2_DONGSHANPIONE_MAIN
        bool "dongshanpi one main"
        select BR2_DONGSHANPIONE

config BR2_DONGSHANPIONE_RESCUE
        bool "dongshanpi one rescue"
        select BR2_DONGSHANPIONE
```

## br2dongshanpione/board/100ask/dongshanpione/kernel.its
```
/dts-v1/;

/ {
	description = "DongshanPi One";
	#address-cells = <1>;

	images {
		kernel-0 {
			data = /incbin/("../../images/zImage");
			type = "kernel";
			arch = "arm";
			os = "linux";
			compression = "none";
			load = <0x21800000>;
                        entry = <0x21800000>;
			hash-1 {
				algo = "crc32";
			};
			hash-2 {
				algo = "sha1";
			};
		};
		fdt-dongshanpione {
			data = /incbin/("../../images/mstar-infinity2m-ssd202d-100ask-dongshanpione.dtb");
			type = "flat_dt";
			arch = "arm";
			compression = "none";
			load = <0x23800000>;
			hash-1 {
				algo = "crc32";
			};
			hash-2 {
				algo = "sha1";
			};
		};
		fdt-dongshanpione-carrier {
			data = /incbin/("../../images/mstar-infinity2m-ssd202d-100ask-dongshanpione-carrier.dtb");
			type = "flat_dt";
			arch = "arm";
			compression = "none";
			load = <0x23800000>;
			hash-1 {
				algo = "crc32";
			};
			hash-2 {
				algo = "sha1";
			};
		};
		fdto-lcd0 {
			data = /incbin/("../../images/mstar-infinity2m-ssd202d-100ask-dongshanpione-100ask_lcd0.dtb");
			type = "flat_dt";
			arch = "arm";
			compression = "none";
			hash-1 {
				algo = "crc32";
			};
			hash-2 {
				algo = "sha1";
			};
		};
		fdto-ili9341 {
			data = /incbin/("../../images/mstar-infinity2m-ssd202d-100ask-dongshanpione-ili9341.dtb");
			type = "flat_dt";
			arch = "arm";
			compression = "none";
			hash-1 {
				algo = "crc32";
			};
			hash-2 {
				algo = "sha1";
			};
		};
	};

	configurations {
		default = "ssd202d-dongshanpione";
		ssd202d-dongshanpione {
			description = "DongShanPi One";
			kernel = "kernel-0";
			fdt = "fdt-dongshanpione";
		};
		ssd202d-dongshanpione-carrier {
			description = "DongShanPi One on carrier";
			kernel = "kernel-0";
			fdt = "fdt-dongshanpione-carrier";
		};
		lcd0 {
			description = "lcd0 overlay";
			fdt = "fdto-lcd0";
		};
		ili9341 {
			description = "ili9341 overlay";
			fdt = "fdto-ili9341";
		};
	};
};
```

## br2dongshanpione/board/100ask/dongshanpione/kernel_rescue.its
```
/dts-v1/;

/ {
	description = "DongshanPi One";
	#address-cells = <1>;

	images {
		kernel-0 {
			data = /incbin/("../../images/zImage");
			type = "kernel";
			arch = "arm";
			os = "linux";
			compression = "none";
			load = <0x21800000>;
                        entry = <0x21800000>;
			hash-1 {
				algo = "crc32";
			};
			hash-2 {
				algo = "sha1";
			};
		};
		fdt-dongshanpione {
			data = /incbin/("../../images/mstar-infinity2m-ssd202d-100ask-dongshanpione.dtb");
			type = "flat_dt";
			arch = "arm";
			compression = "none";
			hash-1 {
				algo = "crc32";
			};
			hash-2 {
				algo = "sha1";
			};
		};
		fdt-dongshanpione-carrier {
			data = /incbin/("../../images/mstar-infinity2m-ssd202d-100ask-dongshanpione-carrier.dtb");
			type = "flat_dt";
			arch = "arm";
			compression = "none";
			hash-1 {
				algo = "crc32";
			};
			hash-2 {
				algo = "sha1";
			};
		};
		ramdisk-0 {
			data = /incbin/("../../images/rootfs.cpio.lz4");
			type = "ramdisk";
			arch = "arm";
			os = "linux";
			compression = "none";
			hash-1 {
				algo = "crc32";
			};
			hash-2 {
				algo = "sha1";
			};
		};
	};

	configurations {
		default = "ssd202d-dongshanpione";
		ssd202d-dongshanpione {
			description = "DongShanPi One";
			kernel = "kernel-0";
			fdt = "fdt-dongshanpione";
			ramdisk = "ramdisk-0";
		};
		ssd202d-dongshanpione-carrier {
			description = "DongShanPi One on carrier";
			kernel = "kernel-0";
			fdt = "fdt-dongshanpione-carrier";
			ramdisk = "ramdisk-0";
		};
	};
};
```

## br2dongshanpione/configs/dongshanpione_rescue_defconfig
```kconfig
BR2_arm=y
BR2_cortex_a7=y
BR2_ARM_FPU_NEON_VFPV4=y
BR2_TOOLCHAIN_BUILDROOT_MUSL=y
BR2_BINUTILS_VERSION_2_39_X=y
BR2_GCC_VERSION_12_X=y
BR2_CPAN_MIRROR="http://cpan.metacpan.org"
BR2_ENABLE_LTO=y
BR2_REPRODUCIBLE=y
# BR2_PIC_PIE is not set
BR2_SSP_NONE=y
BR2_RELRO_NONE=y
# BR2_TARGET_GENERIC_REMOUNT_ROOTFS_RW is not set
BR2_SYSTEM_DHCP="eth0"
BR2_ROOTFS_POST_IMAGE_SCRIPT="support/scripts/genimage.sh"
BR2_ROOTFS_POST_SCRIPT_ARGS="-c $(BR2_EXTERNAL_DONGSHANPIONE_PATH)/board/100ask/dongshanpione/genimage_rescue.cfg"
BR2_LINUX_KERNEL_CUSTOM_GIT=y
BR2_LINUX_KERNEL_CUSTOM_REPO_VERSION="mstar_v6_2_rebase"
BR2_LINUX_KERNEL_USE_CUSTOM_CONFIG=y
BR2_LINUX_KERNEL_CUSTOM_CONFIG_FILE="$(BR2_EXTERNAL_DONGSHANPIONE_PATH)/board/100ask/dongshanpione/linux.config"
BR2_LINUX_KERNEL_CONFIG_FRAGMENT_FILES="$(BR2_EXTERNAL_DONGSHANPIONE_PATH)/board/100ask/dongshanpione/kernel_rescue.fragment"
BR2_LINUX_KERNEL_XZ=y
BR2_LINUX_KERNEL_INTREE_DTS_NAME="mstar-infinity2m-ssd202d-100ask-dongshanpione mstar-infinity2m-ssd202d-100ask-dongshanpione-carrier"
BR2_PACKAGE_MTD=y
# BR2_PACKAGE_MTD_FLASHCP is not set
# BR2_PACKAGE_MTD_FLASH_ERASE is not set
# BR2_PACKAGE_MTD_FLASH_LOCK is not set
# BR2_PACKAGE_MTD_FLASH_UNLOCK is not set
# BR2_PACKAGE_MTD_MTD_DEBUG is not set
# BR2_PACKAGE_MTD_NANDDUMP is not set
# BR2_PACKAGE_MTD_NANDTEST is not set
# BR2_PACKAGE_MTD_NANDWRITE is not set
# BR2_PACKAGE_MTD_MTDINFO is not set
BR2_PACKAGE_LIBGPIOD=y
BR2_PACKAGE_LIBGPIOD_TOOLS=y
BR2_PACKAGE_LRZSZ=y
BR2_TARGET_ROOTFS_CPIO=y
BR2_TARGET_ROOTFS_CPIO_LZ4=y
# BR2_TARGET_ROOTFS_TAR is not set
BR2_DONGSHANPIONE_RESCUE=y
BR2_PACKAGE_SANETIME=y
```
